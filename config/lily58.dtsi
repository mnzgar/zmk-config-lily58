/ {
    left_encoder: encoder_left {
        compatible = "alps,ec11";

        a-gpios = <&gpio0 21 GPIO_ACTIVE_HIGH>;
        b-gpios = <&gpio0 20 GPIO_ACTIVE_HIGH>;

        steps = <80>;
    };

    right_encoder: encoder_right {
        compatible = "alps,ec11";

        a-gpios = <&gpio0 8 GPIO_ACTIVE_HIGH>;
        b-gpios = <&gpio0 9 GPIO_ACTIVE_HIGH>;

        steps = <80>;
    };

    sensors {
        compatible = "zmk,keymap-sensors";

        sensors = <&left_encoder &right_encoder>;
        triggers-per-rotation = <20>;
    };
};